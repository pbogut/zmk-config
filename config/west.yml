## config/west.yml
```yaml
manifest:
  remotes:
    - name: zmkfirmware
      url-base: https://github.com/zmkfirmware
  projects:
    - name: zmk
      remote: zmkfirmware
      revision: 6f85f48b19afae04f98e9abacb36ce1425b61f78
      import: app/west.yml
  self:
    path: config
```

## custom_modules/pbogut/boards/shields/dactyl_gaming/Kconfig.defconfig
```kconfig
if SHIELD_DACTYL_GAMING

config ZMK_KEYBOARD_NAME
    default "Dactyl Gaming"

endif
```

## custom_modules/pbogut/boards/shields/equals60_nicenano2/Kconfig.defconfig
```kconfig
# Copyright (c) 2021 The ZMK Contributors
# SPDX-License-Identifier: MIT

if SHIELD_EQUALS60_NN

config ZMK_KEYBOARD_NAME
    default "equals60_nnv2"

endif
```

## shields/dactyl_gaming/boards/shields/equals60_nicenano2/Kconfig.shield
```kconfig
# Copyright (c) 2021 The ZMK Contributors
# SPDX-License-Identifier: MIT

config SHIELD_EQUALS60_NN
    def_bool $(shields_list_contains,equals60_nnv2)
```
